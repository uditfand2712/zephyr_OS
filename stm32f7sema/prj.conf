## CMakeLists.txt
```
cmake_minimum_required(VERSION 3.20.0)

# Find Zephyr (west sets ZEPHYR_BASE)
find_package(Zephyr REQUIRED HINTS $ENV{ZEPHYR_BASE})

project(stm32f7sema)

# Add your source files
target_sources(app PRIVATE src/main.c)
```

## prj.conf
```kconfig
# Enable logging
CONFIG_LOG=y
CONFIG_LOG_DEFAULT_LEVEL=3

# Enable console output
CONFIG_SERIAL=y
CONFIG_UART_CONSOLE=y
```

## src/main.c
```c
#include <zephyr/kernel.h>
#include <zephyr/logging/log.h>

LOG_MODULE_REGISTER(main, LOG_LEVEL_INF);

int	main(void)
{
	while (1)
	{
		LOG_INF("Hello world from stm32f767zi !");
		k_sleep(K_SECONDS(1));
	}
	return (0);
}
```
