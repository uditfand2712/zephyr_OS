## CMakeLists.txt
```
cmake_minimum_required(VERSION 3.20.0)

# Find Zephyr (west sets ZEPHYR_BASE)
find_package(Zephyr REQUIRED HINTS $ENV{ZEPHYR_BASE})

project(qemu_threads)

# Add your source files
target_sources(app PRIVATE src/main.c)
```

## prj.conf
```kconfig
# Enable logging
CONFIG_LOG=y
CONFIG_LOG_DEFAULT_LEVEL=3

# Enable console output
CONFIG_SERIAL=y
CONFIG_UART_CONSOLE=y
```

## src/main.c
```c
#include <zephyr/kernel.h>
#include <zephyr/sys/printk.h>
#define THREAD_PRIORITY 7
#define STACK_SIZE 1024
void thread1_func(void *arg1, void *arg2, void *arg3);
void thread2_func(void *arg1, void *arg2, void *arg3);
/* Thread control blocks */
struct k_thread thread1;
struct k_thread thread2;
K_THREAD_STACK_DEFINE(thread1_stack, STACK_SIZE);
K_THREAD_STACK_DEFINE(thread2_stack, STACK_SIZE);
int main(void)
{
    printk("Hello from QEMU Threads example!\n");
    k_thread_create(&thread1, thread1_stack, STACK_SIZE,
                    thread1_func, NULL, NULL, NULL,
                    THREAD_PRIORITY, 0, K_NO_WAIT);

    /* Create thread 2 */
    k_thread_create(&thread2, thread2_stack, STACK_SIZE,
                    thread2_func, NULL, NULL, NULL,
                    THREAD_PRIORITY, 0, K_NO_WAIT);

    /* Create threads here if needed */

    return 0;
}

void thread1_func(void *arg1, void *arg2, void *arg3)
{
    while (1)
    {
        printk("Thread 1: Running\n");
        k_sleep(K_MSEC(500)); // Sleep for 500 milliseconds
    }
}
void thread2_func(void *arg1, void *arg2, void *arg3)
{
    while (1)
    {
        printk("Thread 2: Running\n");
        k_sleep(K_MSEC(500)); // Sleep for 500 milliseconds
    }
}
```
