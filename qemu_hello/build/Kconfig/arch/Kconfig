## qemu_hello/build/Kconfig/arch/Kconfig
```kconfig
# Load Zephyr Arch Kconfig descriptions.
osource "/home/udit27/zephyrproject/zephyr/arch/rx/Kconfig"
osource "/home/udit27/zephyrproject/zephyr/arch/x86/Kconfig"
osource "/home/udit27/zephyrproject/zephyr/arch/xtensa/Kconfig"
osource "/home/udit27/zephyrproject/zephyr/arch/sparc/Kconfig"
osource "/home/udit27/zephyrproject/zephyr/arch/riscv/Kconfig"
osource "/home/udit27/zephyrproject/zephyr/arch/posix/Kconfig"
osource "/home/udit27/zephyrproject/zephyr/arch/mips/Kconfig"
osource "/home/udit27/zephyrproject/zephyr/arch/arm64/Kconfig"
osource "/home/udit27/zephyrproject/zephyr/arch/arm/Kconfig"
osource "/home/udit27/zephyrproject/zephyr/arch/arc/Kconfig"
```

## qemu_hello/build/Kconfig/boards/Kconfig.defconfig
```kconfig
# Load Zephyr board defconfig descriptions.
osource "/home/udit27/zephyrproject/zephyr/boards/qemu/cortex_m3/Kconfig.defconfig"
```

## qemu_hello/build/Kconfig/boards/Kconfig.qemu_cortex_m3
```kconfig
# Load board Kconfig descriptions.
osource "/home/udit27/zephyrproject/zephyr/boards/qemu/cortex_m3/Kconfig.qemu_cortex_m3"
```

## qemu_hello/build/Kconfig/boards/Kconfig.sysbuild
```kconfig
# Load Sysbuild board Kconfig descriptions.
osource "/home/udit27/zephyrproject/zephyr/boards/qemu/cortex_m3/Kconfig.sysbuild"
```

## qemu_hello/build/Kconfig/soc/Kconfig
```kconfig
# Load Zephyr SoC Kconfig descriptions.
osource "/home/udit27/zephyrproject/zephyr/soc/xlnx/zynqmp/Kconfig"
osource "/home/udit27/zephyrproject/zephyr/soc/xlnx/zynq7000/Kconfig"
osource "/home/udit27/zephyrproject/zephyr/soc/xlnx/versalnet/Kconfig"
osource "/home/udit27/zephyrproject/zephyr/soc/xlnx/versal2/Kconfig"
osource "/home/udit27/zephyrproject/zephyr/soc/xen/Kconfig"
osource "/home/udit27/zephyrproject/zephyr/soc/wch/ch32v/Kconfig"
osource "/home/udit27/zephyrproject/zephyr/soc/ti/simplelink/Kconfig"
osource "/home/udit27/zephyrproject/zephyr/soc/ti/mspm0/Kconfig"
osource "/home/udit27/zephyrproject/zephyr/soc/ti/lm3s6965/Kconfig"
osource "/home/udit27/zephyrproject/zephyr/soc/ti/k3/Kconfig"
osource "/home/udit27/zephyrproject/zephyr/soc/telink/tlsr/Kconfig"
osource "/home/udit27/zephyrproject/zephyr/soc/starfive/jh71xx/Kconfig"
osource "/home/udit27/zephyrproject/zephyr/soc/st/stm32/Kconfig"
osource "/home/udit27/zephyrproject/zephyr/soc/snps/qemu_arc/Kconfig"
osource "/home/udit27/zephyrproject/zephyr/soc/snps/nsim/arc_v/Kconfig"
osource "/home/udit27/zephyrproject/zephyr/soc/snps/nsim/arc_classic/Kconfig"
osource "/home/udit27/zephyrproject/zephyr/soc/snps/hsdk4xd/Kconfig"
osource "/home/udit27/zephyrproject/zephyr/soc/snps/hsdk/Kconfig"
osource "/home/udit27/zephyrproject/zephyr/soc/snps/emsk/Kconfig"
osource "/home/udit27/zephyrproject/zephyr/soc/snps/emsdp/Kconfig"
osource "/home/udit27/zephyrproject/zephyr/soc/snps/arc_iot/Kconfig"
osource "/home/udit27/zephyrproject/zephyr/soc/silabs/Kconfig"
osource "/home/udit27/zephyrproject/zephyr/soc/sifli/sf32/Kconfig"
osource "/home/udit27/zephyrproject/zephyr/soc/sifive/sifive_freedom/Kconfig"
osource "/home/udit27/zephyrproject/zephyr/soc/sensry/Kconfig"
osource "/home/udit27/zephyrproject/zephyr/soc/rockchip/Kconfig"
osource "/home/udit27/zephyrproject/zephyr/soc/renode/riscv_virtual/Kconfig"
osource "/home/udit27/zephyrproject/zephyr/soc/renode/cortex_r8_virtual/Kconfig"
osource "/home/udit27/zephyrproject/zephyr/soc/renesas/smartbond/Kconfig"
osource "/home/udit27/zephyrproject/zephyr/soc/renesas/rz/Kconfig"
osource "/home/udit27/zephyrproject/zephyr/soc/renesas/rx/Kconfig"
osource "/home/udit27/zephyrproject/zephyr/soc/renesas/rcar/Kconfig"
osource "/home/udit27/zephyrproject/zephyr/soc/renesas/ra/Kconfig"
osource "/home/udit27/zephyrproject/zephyr/soc/realtek/ec/Kconfig"
osource "/home/udit27/zephyrproject/zephyr/soc/raspberrypi/rpi_pico/Kconfig"
osource "/home/udit27/zephyrproject/zephyr/soc/quicklogic/eos_s3/Kconfig"
osource "/home/udit27/zephyrproject/zephyr/soc/qemu/virt_riscv/Kconfig"
osource "/home/udit27/zephyrproject/zephyr/soc/qemu/malta/Kconfig"
osource "/home/udit27/zephyrproject/zephyr/soc/openisa/rv32m1/Kconfig"
osource "/home/udit27/zephyrproject/zephyr/soc/openhwgroup/cva6/Kconfig"
osource "/home/udit27/zephyrproject/zephyr/soc/oct/osd32mp15x/Kconfig"
osource "/home/udit27/zephyrproject/zephyr/soc/nxp/s32/Kconfig"
osource "/home/udit27/zephyrproject/zephyr/soc/nxp/rw/Kconfig"
osource "/home/udit27/zephyrproject/zephyr/soc/nxp/mcx/Kconfig"
osource "/home/udit27/zephyrproject/zephyr/soc/nxp/lpc/Kconfig"
osource "/home/udit27/zephyrproject/zephyr/soc/nxp/layerscape/Kconfig"
osource "/home/udit27/zephyrproject/zephyr/soc/nxp/kinetis/Kconfig"
osource "/home/udit27/zephyrproject/zephyr/soc/nxp/imxrt/Kconfig"
osource "/home/udit27/zephyrproject/zephyr/soc/nxp/imx/Kconfig"
osource "/home/udit27/zephyrproject/zephyr/soc/nuvoton/numicro/Kconfig"
osource "/home/udit27/zephyrproject/zephyr/soc/nuvoton/numaker/Kconfig"
osource "/home/udit27/zephyrproject/zephyr/soc/nuvoton/npcx/Kconfig"
osource "/home/udit27/zephyrproject/zephyr/soc/nuvoton/npcm/Kconfig"
osource "/home/udit27/zephyrproject/zephyr/soc/nordic/Kconfig"
osource "/home/udit27/zephyrproject/zephyr/soc/neorv32/Kconfig"
osource "/home/udit27/zephyrproject/zephyr/soc/native/inf_clock/Kconfig"
osource "/home/udit27/zephyrproject/zephyr/soc/microchip/sam/Kconfig"
osource "/home/udit27/zephyrproject/zephyr/soc/microchip/sam/sama7/Kconfig"
osource "/home/udit27/zephyrproject/zephyr/soc/microchip/sam/sam_d5x_e5x/Kconfig"
osource "/home/udit27/zephyrproject/zephyr/soc/microchip/pic32c/pic32cz_ca/Kconfig"
osource "/home/udit27/zephyrproject/zephyr/soc/microchip/pic32c/pic32cx_sg/Kconfig"
osource "/home/udit27/zephyrproject/zephyr/soc/microchip/pic32c/pic32cm_jh/Kconfig"
osource "/home/udit27/zephyrproject/zephyr/soc/microchip/miv/Kconfig"
osource "/home/udit27/zephyrproject/zephyr/soc/microchip/mec/Kconfig"
osource "/home/udit27/zephyrproject/zephyr/soc/mediatek/mt8xxx/Kconfig"
osource "/home/udit27/zephyrproject/zephyr/soc/lowrisc/opentitan/Kconfig"
osource "/home/udit27/zephyrproject/zephyr/soc/litex/litex_vexriscv/Kconfig"
osource "/home/udit27/zephyrproject/zephyr/soc/ite/ec/Kconfig"
osource "/home/udit27/zephyrproject/zephyr/soc/intel/raptor_lake/Kconfig"
osource "/home/udit27/zephyrproject/zephyr/soc/intel/panther_lake/Kconfig"
osource "/home/udit27/zephyrproject/zephyr/soc/intel/lakemont/Kconfig"
osource "/home/udit27/zephyrproject/zephyr/soc/intel/intel_socfpga_std/Kconfig"
osource "/home/udit27/zephyrproject/zephyr/soc/intel/intel_socfpga/Kconfig"
osource "/home/udit27/zephyrproject/zephyr/soc/intel/intel_niosv/Kconfig"
osource "/home/udit27/zephyrproject/zephyr/soc/intel/intel_ish/Kconfig"
osource "/home/udit27/zephyrproject/zephyr/soc/intel/intel_adsp/Kconfig"
osource "/home/udit27/zephyrproject/zephyr/soc/intel/elkhart_lake/Kconfig"
osource "/home/udit27/zephyrproject/zephyr/soc/intel/atom/Kconfig"
osource "/home/udit27/zephyrproject/zephyr/soc/intel/apollo_lake/Kconfig"
osource "/home/udit27/zephyrproject/zephyr/soc/intel/alder_lake/Kconfig"
osource "/home/udit27/zephyrproject/zephyr/soc/infineon/edge/Kconfig"
osource "/home/udit27/zephyrproject/zephyr/soc/infineon/cat3/Kconfig"
osource "/home/udit27/zephyrproject/zephyr/soc/infineon/cat1c/Kconfig"
osource "/home/udit27/zephyrproject/zephyr/soc/infineon/cat1b/Kconfig"
osource "/home/udit27/zephyrproject/zephyr/soc/infineon/cat1a/Kconfig"
osource "/home/udit27/zephyrproject/zephyr/soc/gd/gd32/Kconfig"
osource "/home/udit27/zephyrproject/zephyr/soc/gaisler/leon3/Kconfig"
osource "/home/udit27/zephyrproject/zephyr/soc/gaisler/gr716a/Kconfig"
osource "/home/udit27/zephyrproject/zephyr/soc/espressif/Kconfig"
osource "/home/udit27/zephyrproject/zephyr/soc/ene/kb1200/Kconfig"
osource "/home/udit27/zephyrproject/zephyr/soc/ene/kb106x/Kconfig"
osource "/home/udit27/zephyrproject/zephyr/soc/egis/Kconfig"
osource "/home/udit27/zephyrproject/zephyr/soc/efinix/sapphire/Kconfig"
osource "/home/udit27/zephyrproject/zephyr/soc/cdns/xtensa_sample_controller/Kconfig"
osource "/home/udit27/zephyrproject/zephyr/soc/cdns/sample_controller32/Kconfig"
osource "/home/udit27/zephyrproject/zephyr/soc/cdns/dc233c/Kconfig"
osource "/home/udit27/zephyrproject/zephyr/soc/brcm/bcmvk/Kconfig"
osource "/home/udit27/zephyrproject/zephyr/soc/brcm/bcm2712/Kconfig"
osource "/home/udit27/zephyrproject/zephyr/soc/brcm/bcm2711/Kconfig"
osource "/home/udit27/zephyrproject/zephyr/soc/bflb/Kconfig"
osource "/home/udit27/zephyrproject/zephyr/soc/atmel/sam0/Kconfig"
osource "/home/udit27/zephyrproject/zephyr/soc/atmel/sam/Kconfig"
osource "/home/udit27/zephyrproject/zephyr/soc/aspeed/Kconfig"
osource "/home/udit27/zephyrproject/zephyr/soc/arm/Kconfig"
osource "/home/udit27/zephyrproject/zephyr/soc/arm/beetle/Kconfig"
osource "/home/udit27/zephyrproject/zephyr/soc/antmicro/myra/Kconfig"
osource "/home/udit27/zephyrproject/zephyr/soc/andestech/Kconfig"
osource "/home/udit27/zephyrproject/zephyr/soc/amd/acp_6_0/Kconfig"
osource "/home/udit27/zephyrproject/zephyr/soc/ambiq/Kconfig"
osource "/home/udit27/zephyrproject/zephyr/soc/aesc/Kconfig"
osource "/home/udit27/zephyrproject/zephyr/soc/adi/max32/Kconfig"
```

## qemu_hello/west.yml
```yaml
manifest:
  self:
    path: .
  remotes:
    - name: zephyrproject
      url-base: https://github.com/zephyrproject-rtos
  projects:
    - name: zephyr
      remote: zephyrproject
      revision: main
      path: zephyr
    - name: littlefs
      remote: zephyrproject
      revision: main
      path: modules/fs/littlefs
```

## qemu_threads/build/Kconfig/arch/Kconfig
```kconfig
# Load Zephyr Arch Kconfig descriptions.
osource "/home/udit/zephyrproject/zephyr/arch/rx/Kconfig"
osource "/home/udit/zephyrproject/zephyr/arch/x86/Kconfig"
osource "/home/udit/zephyrproject/zephyr/arch/xtensa/Kconfig"
osource "/home/udit/zephyrproject/zephyr/arch/sparc/Kconfig"
osource "/home/udit/zephyrproject/zephyr/arch/riscv/Kconfig"
osource "/home/udit/zephyrproject/zephyr/arch/posix/Kconfig"
osource "/home/udit/zephyrproject/zephyr/arch/openrisc/Kconfig"
osource "/home/udit/zephyrproject/zephyr/arch/mips/Kconfig"
osource "/home/udit/zephyrproject/zephyr/arch/arm64/Kconfig"
osource "/home/udit/zephyrproject/zephyr/arch/arm/Kconfig"
osource "/home/udit/zephyrproject/zephyr/arch/arc/Kconfig"
```

## qemu_threads/build/Kconfig/boards/Kconfig.defconfig
```kconfig
# Load Zephyr board defconfig descriptions.
osource "/home/udit/zephyrproject/zephyr/boards/qemu/cortex_m3/Kconfig.defconfig"
```

## qemu_threads/build/Kconfig/boards/Kconfig.qemu_cortex_m3
```kconfig
# Load board Kconfig descriptions.
osource "/home/udit/zephyrproject/zephyr/boards/qemu/cortex_m3/Kconfig.qemu_cortex_m3"
```

## qemu_threads/build/Kconfig/boards/Kconfig.sysbuild
```kconfig
# Load Sysbuild board Kconfig descriptions.
osource "/home/udit/zephyrproject/zephyr/boards/qemu/cortex_m3/Kconfig.sysbuild"
```
